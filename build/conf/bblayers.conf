## build/conf/bblayers.conf
```bitbake
# POKY_BBLAYERS_CONF_VERSION is increased each time build/conf/bblayers.conf
# changes incompatibly
POKY_BBLAYERS_CONF_VERSION = "2"

BBPATH = "${TOPDIR}"
BBFILES ?= ""

YOCTOROOT = "${@os.path.abspath(os.path.join("${TOPDIR}", os.pardir))}"

LAYERSERIES_COMPAT_meta-sunxi:append = " hardknott honister"

BBLAYERS ?= " \
  ${YOCTOROOT}/layers/meta-arm/meta-arm \
  ${YOCTOROOT}/layers/meta-arm/meta-arm-toolchain \
  ${YOCTOROOT}/layers/meta-clang \
  ${YOCTOROOT}/layers/meta-dev1990 \
  ${YOCTOROOT}/layers/meta-intel \
  ${YOCTOROOT}/layers/meta-kodi \
  ${YOCTOROOT}/layers/meta-openembedded/meta-multimedia \
  ${YOCTOROOT}/layers/meta-openembedded/meta-networking \
  ${YOCTOROOT}/layers/meta-openembedded/meta-oe \
  ${YOCTOROOT}/layers/meta-openembedded/meta-python \
  ${YOCTOROOT}/layers/meta-qt5 \
  ${YOCTOROOT}/layers/meta-raspberrypi \
  ${YOCTOROOT}/layers/meta-raspberrypi-extras \
  ${YOCTOROOT}/layers/meta-retro \
  ${YOCTOROOT}/layers/meta-rockchip \
  ${YOCTOROOT}/layers/meta-rockchip-extras \
  ${YOCTOROOT}/layers/meta-sunxi \
  ${YOCTOROOT}/layers/meta-wayland \
  ${YOCTOROOT}/poky/meta \
  ${YOCTOROOT}/poky/meta-poky \
  ${YOCTOROOT}/poky/meta-yocto-bsp \
"
```
